## prj.conf
```kconfig
CONFIG_PRINTK=y
CONFIG_LOG=y

# Heap and stack size settings
CONFIG_HEAP_MEM_POOL_SIZE=1024
CONFIG_MAIN_STACK_SIZE=2048
CONFIG_SYSTEM_WORKQUEUE_STACK_SIZE=2048

# Stack analysis settings
CONFIG_STACK_SENTINEL=y
CONFIG_STACK_USAGE=y
CONFIG_INIT_STACKS=y

CONFIG_THREAD_MONITOR=y
CONFIG_THREAD_NAME=y
CONFIG_BOOT_BANNER=y

# Shells
CONFIG_SHELL=y
CONFIG_KERNEL_SHELL=y
CONFIG_DEVICE_SHELL=y

# BCB
CONFIG_BCB_SHELL=y
CONFIG_BCB_COAP=y

# Network settings
CONFIG_NETWORKING=y
CONFIG_NET_LOG=n
CONFIG_NET_IPV6=n
CONFIG_NET_IPV4=y
CONFIG_NET_DHCPV4=y
CONFIG_NET_UDP=y
CONFIG_NET_TCP=y
CONFIG_NET_STATISTICS=y
CONFIG_NET_SOCKETS=y
CONFIG_NET_SOCKETS_POSIX_NAMES=y
CONFIG_NET_CONNECTION_MANAGER=y
CONFIG_NET_CONFIG_SETTINGS=y
CONFIG_NET_CONFIG_AUTO_INIT=y
CONFIG_NET_SHELL=y
CONFIG_NET_BUF_USER_DATA_SIZE=24

# CoAP settings
CONFIG_COAP=y
CONFIG_COAP_WELL_KNOWN_BLOCK_WISE=n
```

## src/main.c
```c
/*
 * Copyright (c) 2015 Intel Corporation
 *
 * SPDX-License-Identifier: Apache-2.0
 */

#include "kernel.h"
#include <zephyr.h>
#include <bcb_coap.h>

#define LOG_LEVEL LOG_LEVEL_INF
#include <logging/log.h>
LOG_MODULE_REGISTER(bcb_coap_app);

void main(void)
{
    LOG_INF("Coap Test Application");
    bcb_coap_start_server();
    while(1) {
        k_sleep(K_MSEC(1000));
    }
}
```
