## CMakeLists.txt
```
cmake_minimum_required(VERSION 3.20.0)

find_package(Zephyr REQUIRED HINTS $ENV{ZEPHYR_BASE})

project(zero)
add_subdirectory(src)
```

## sample.yaml
```
sample:
  name: Zero
tests:
  sample.basic.blinky:
    tags: LED gpio
    filter: dt_compat_enabled_with_alias("gpio-leds", "led0")
    depends_on: gpio
    harness: led
```

## prj.conf
```kconfig
# Heap and stack size settings
CONFIG_HEAP_MEM_POOL_SIZE=2048
CONFIG_MAIN_STACK_SIZE=4096
CONFIG_SYSTEM_WORKQUEUE_STACK_SIZE=4096

# Stack analysis settings
CONFIG_STACK_SENTINEL=y
CONFIG_STACK_USAGE=y
CONFIG_INIT_STACKS=y

# Thread settings
CONFIG_THREAD_MONITOR=n
CONFIG_THREAD_NAME=y

# Shells
CONFIG_SHELL=y
CONFIG_KERNEL_SHELL=y
CONFIG_DEVICE_SHELL=y
CONFIG_SHELL_BACKENDS=y
CONFIG_SHELL_BACKEND_TELNET=y

# Network settings
CONFIG_NETWORKING=y
CONFIG_NET_LOG=y
CONFIG_NET_IPV6=n
CONFIG_NET_IPV4=y
CONFIG_NET_DHCPV4=y
CONFIG_NET_UDP=y
CONFIG_NET_TCP=y
CONFIG_NET_STATISTICS=y
CONFIG_NET_SOCKETS=y
CONFIG_NET_SOCKETS_POSIX_NAMES=y
CONFIG_NET_CONNECTION_MANAGER=y
CONFIG_NET_MGMT=y
CONFIG_NET_MGMT_EVENT=y
#CONFIG_NET_CONFIG_SETTINGS=y
CONFIG_NET_CONFIG_AUTO_INIT=n
CONFIG_NET_SHELL=y
CONFIG_NET_BUF_USER_DATA_SIZE=24
CONFIG_NET_MAX_CONN=10

# CoAP settings
CONFIG_COAP=y
CONFIG_COAP_WELL_KNOWN_BLOCK_WISE=n

# MCU manager settings
CONFIG_MCUMGR=y
CONFIG_MCUMGR_CMD_IMG_MGMT=y
CONFIG_MCUMGR_CMD_OS_MGMT=y
CONFIG_MCUMGR_SMP_UDP=y
CONFIG_MCUMGR_SMP_UDP_IPV4=y
CONFIG_MCUMGR_SMP_UDP_IPV6=n

# Other settings
CONFIG_PRINTK=y
CONFIG_LOG=y
CONFIG_BOOT_BANNER=y
CONFIG_FLASH=y
CONFIG_BOOTLOADER_MCUBOOT=y

# BCB
CONFIG_BCB_SHELL=y
CONFIG_BCB_COAP=y
CONFIG_ZERO_CONTROL_MESSAGES=y
CONFIG_ZERO_NANOPB_INTERNAL=y

CONFIG_EEPROM_SHELL=y
```

## src/main.c
```c
#include "adc_test.h"

#include <zephyr/kernel.h>

#ifdef CONFIG_MCUMGR_CMD_IMG_MGMT
#include "img_mgmt/img_mgmt.h"
#endif

#include "networking.h"
#include "services.h"

#include <zephyr/logging/log.h>
LOG_MODULE_REGISTER(main);

void main(void)
{
	LOG_INF("app: zero, built: " __DATE__ " " __TIME__);
	LOG_INF("board: " CONFIG_BOARD);

#ifdef CONFIG_MCUMGR_CMD_IMG_MGMT
	{
		int r;
		struct image_version version;
		r = img_mgmt_my_version(&version);
		if (!r) {
			LOG_INF("version: %" PRIu8 ".%" PRIu8 ".%" PRIu16 " (%" PRIu32 ")",
				version.iv_major, version.iv_minor, version.iv_revision,
				version.iv_build_num);
		} else {
			LOG_WRN("cannot get version");
		}
	}
#endif

	networking_init();
	services_init();
	adc_test_init();

	while (1) {
		k_sleep(K_MSEC(1000));
	}
}
```

## src/adc_test.c
```c
#include "adc_test.h"

#include <zephyr/drivers/adc_dma.h>
#include <zephyr/kernel.h>

#define LOG_LEVEL CONFIG_ADC_LOG_LEVEL
#include <zephyr/logging/log.h>
LOG_MODULE_REGISTER(adc_test);

#define Z_ADC_DEV(inst)	    (adc_test_data.dev_adc_##inst)
#define Z_ADC_SEQ_IDX(inst) (adc_test_data.seq_idx_adc_##inst)

#define Z_ADC_DEV_LABEL(node_label, ch_name)                                                       \
	DEVICE_DT_NAME(DT_PHANDLE_BY_NAME(DT_NODELABEL(node_label), io_channels, ch_name))

#define Z_ADC_CHANNEL(node_label, ch_name)                                                         \
	DT_PHA_BY_NAME(DT_NODELABEL(node_label), io_channels, ch_name, main)

#define Z_ADC_CHANNEL_ALT(node_label, ch_name)                                                     \
	DT_PHA_BY_NAME(DT_NODELABEL(node_label), io_channels, ch_name, alt)

#define Z_ADC_CHANNEL_TYPE(node_label, ch_name)                                                    \
	DT_PHA_BY_NAME(DT_NODELABEL(node_label), io_channels, ch_name, type)

#define Z_ADC_SEQ_ADD(inst, node_label, ch_name)                                                   \
	do {                                                                                       \
		struct adc_dma_channel_config config;                                              \
		config.channel = Z_ADC_CHANNEL(node_label, ch_name);                               \
		config.alt_channel = Z_ADC_CHANNEL_ALT(node_label, ch_name);                       \
		config.type = Z_ADC_CHANNEL_TYPE(node_label, ch_name);                             \
		const struct device *dev =                                                         \
			device_get_binding(Z_ADC_DEV_LABEL(node_label, ch_name));                  \
		if (dev == Z_ADC_DEV(inst)) {                                                      \
			int r;                                                                     \
			r = adc_dma_add_channel(dev, &config, Z_ADC_SEQ_IDX(inst)++);              \
			if (r) {                                                                   \
				LOG_ERR("cannot setup adc##inst channel: %" PRIu8 ", %" PRIu8,     \
					config.channel, config.alt_channel);                       \
				return r;                                                          \
			}                                                                          \
		} else {                                                                           \
			LOG_ERR("invalid adc device");                                             \
			return -EINVAL;                                                            \
		}                                                                                  \
	} while (0)

#define Z_ADC_INIT(inst)                                                                           \
	do {                                                                                       \
		Z_ADC_DEV(inst) = device_get_binding(DEVICE_DT_NAME(DT_NODELABEL(adc##inst)));     \
		if (Z_ADC_DEV(inst) == NULL) {                                                     \
			LOG_ERR("cannot get adc device");                                          \
			return -EINVAL;                                                            \
		}                                                                                  \
	} while (0);

#define MAX_SAMPLES 150

typedef struct adc_test_data {
	const struct device *dev_adc_0;
	uint8_t seq_idx_adc_0;

	uint16_t buf_adc_0[MAX_SAMPLES] __attribute__((aligned(2)));
} adc_test_data_t;

static adc_test_data_t adc_test_data;

void adc_completed(const struct device *dev, void *buffer, size_t buffer_size)
{
	LOG_INF("buffer 0x%" PRIx32 ", size %" PRId32, (uint32_t)buffer, buffer_size);
}

int adc_test_init(void)
{
	struct adc_dma_sampling_config sampling_config;
	int r;

	Z_ADC_INIT(0);
	Z_ADC_SEQ_ADD(0, aread, i_low_gain);
	Z_ADC_SEQ_ADD(0, aread, v_mains);

	sampling_config.buffer = adc_test_data.buf_adc_0;
	sampling_config.buffer_size = sizeof(adc_test_data.buf_adc_0);
	sampling_config.sequence_length = adc_test_data.seq_idx_adc_0;
	sampling_config.samples_per_channel = MAX_SAMPLES / adc_test_data.seq_idx_adc_0;
	sampling_config.reference = ADC_DMA_REF_EXTERNAL0;
	sampling_config.resolution = 16;
	sampling_config.mode = ADC_DMA_SAMPLING_MODE_CONTINUOUS;
	sampling_config.sample_interval = 1000;
	sampling_config.callback = &adc_completed;

	r = adc_dma_start(Z_ADC_DEV(0), &sampling_config);
	if (r) {
		LOG_ERR("cannot start adc: %d", r);
	}

	k_sleep(K_MSEC(1000));

	adc_dma_stop(Z_ADC_DEV(0));

	return 0;
}
```

## src/adc_test.h
```c
#ifndef _ADC_TEST_H_
#define _ADC_TEST_H_

int adc_test_init(void);

#endif // _ADC_TEST_H_
```

## src/common.h
```c
/*
 * Copyright (c) 2020 Blixt Tech AB 
 *
 * SPDX-License-Identifier: Apache-2.0
 */

void start_smp_udp(void);
```

## src/networking.c
```c
#include "networking.h"
#include <stdint.h>
#include <zephyr/kernel.h>
#include <zephyr/net/net_mgmt.h>
#include <zephyr/net/net_event.h>
#include <zephyr/net/net_conn_mgr.h>
#include <zephyr/net/net_if.h>
#include <zephyr/net/dhcpv4.h>

#ifndef CONFIG_NET_CONFIG_AUTO_INIT
static struct net_mgmt_event_callback callback;
#endif // CONFIG_NET_CONFIG_AUTO_INIT

static void event_handler(struct net_mgmt_event_callback *cb, uint32_t event, struct net_if *iface)
{
	if (event == NET_EVENT_IF_UP) {
		net_dhcpv4_start(iface);
	} else if (event == NET_EVENT_IF_DOWN) {
		net_dhcpv4_stop(iface);
	} else {
		/* Some other event */
	}
}

int networking_init(void)
{
#ifndef CONFIG_NET_CONFIG_AUTO_INIT
	net_mgmt_init_event_callback(&callback, event_handler, NET_EVENT_IF_UP | NET_EVENT_IF_DOWN);
	net_mgmt_add_event_callback(&callback);
#endif // CONFIG_NET_CONFIG_AUTO_INIT
	return 0;
}
```

## src/services.c
```c
#include "services.h"
#include <zephyr/kernel.h>

#ifdef CONFIG_MCUMGR_SMP_UDP
#include <zephyr/mgmt/mcumgr/smp_udp.h>
#endif

#ifdef CONFIG_MCUMGR_CMD_OS_MGMT
#include "os_mgmt/os_mgmt.h"
#endif
#ifdef CONFIG_MCUMGR_CMD_IMG_MGMT
#include "img_mgmt/img_mgmt.h"
#endif

#include <zephyr/logging/log.h>
LOG_MODULE_REGISTER(services);

int services_init(void)
{
#ifdef CONFIG_MCUMGR_CMD_OS_MGMT
	os_mgmt_register_group();
#endif

#ifdef CONFIG_MCUMGR_CMD_IMG_MGMT
	{
		int r;
		struct image_version version;
		img_mgmt_register_group();
		r = img_mgmt_my_version(&version);
		if (!r) {
			LOG_INF("Firmware version %" PRIu8 ".%" PRIu8 ".%" PRIu16 " (%" PRIu32 ")",
				version.iv_major, version.iv_minor, version.iv_revision,
				version.iv_build_num);
		}
	}
#endif

#ifdef CONFIG_MCUMGR_SMP_UDP
	{
		int r = smp_udp_open();
		if (r < 0) {
			LOG_ERR("Cannot not open smp udp %d", r);
			return r;
		}
	}
#endif

	return 0;
}
```

## src/services.h
```c
#ifndef _SERVICES_H_
#define _SERVICES_H_

int services_init(void);

#endif // _SERVICES_H_
```

## src/udp.c
```c
/*
 * Copyright (c) 2020 Blixt Tech AB
 *
 * SPDX-License-Identifier: Apache-2.0
 */

#include <mgmt/smp_udp.h>
#include <net/net_mgmt.h>
#include <net/net_event.h>
#include <net/net_conn_mgr.h>

#define LOG_LEVEL LOG_LEVEL_DBG
#include <logging/log.h>
LOG_MODULE_REGISTER(zero_smp);

#define EVENT_MASK (NET_EVENT_L4_CONNECTED | NET_EVENT_L4_DISCONNECTED)

static struct net_mgmt_event_callback mgmt_cb;

static void event_handler(struct net_mgmt_event_callback *cb,
			  u32_t mgmt_event, struct net_if *iface)
{
	if ((mgmt_event & EVENT_MASK) != mgmt_event) {
		return;
	}

	if (mgmt_event == NET_EVENT_L4_CONNECTED) {
		LOG_INF("Network connected");

		if (smp_udp_open() < 0) {
			LOG_ERR("could not open smp udp");
		}

		return;
	}

	if (mgmt_event == NET_EVENT_L4_DISCONNECTED) {
		LOG_INF("Network disconnected");
		smp_udp_close();
		return;
	}
}

void start_smp_udp(void)
{
	net_mgmt_init_event_callback(&mgmt_cb, event_handler, EVENT_MASK);
	net_mgmt_add_event_callback(&mgmt_cb);
	net_conn_mgr_resend_status();
}
```
