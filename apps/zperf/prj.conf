## CMakeLists.txt
```
# SPDX-License-Identifier: Apache-2.0

cmake_minimum_required(VERSION 3.13.1)

include("${CMAKE_CURRENT_LIST_DIR}/../../cmake/zephyr.cmake")

project(zperf)

target_sources(app PRIVATE
  src/shell_utils.c
  src/zperf_session.c
  src/zperf_shell.c
  src/zperf_udp_receiver.c
  src/zperf_udp_uploader.c
  src/zperf_tcp_receiver.c
  src/zperf_tcp_uploader.c
  src/main.c
  )

target_include_directories(app PRIVATE
  ${ZEPHYR_BASE}/subsys/net/ip
  )
```

## prj.conf
```kconfig
CONFIG_NETWORKING=y
CONFIG_NET_LOG=y
CONFIG_NET_IPV6=n
CONFIG_NET_IPV4=y
CONFIG_NET_DHCPV4=y
CONFIG_NET_UDP=y
CONFIG_NET_TCP=y
CONFIG_NET_STATISTICS=y

CONFIG_NET_PKT_RX_COUNT=14
CONFIG_NET_PKT_TX_COUNT=14
CONFIG_NET_BUF_RX_COUNT=28
CONFIG_NET_BUF_TX_COUNT=28
#CONFIG_NET_IF_UNICAST_IPV6_ADDR_COUNT=4
#CONFIG_NET_IF_MCAST_IPV6_ADDR_COUNT=5
CONFIG_NET_IF_UNICAST_IPV4_ADDR_COUNT=1
CONFIG_NET_MAX_CONTEXTS=5
CONFIG_NET_CONTEXT_SYNC_RECV=y

CONFIG_INIT_STACKS=y
CONFIG_TEST_RANDOM_GENERATOR=y

CONFIG_NET_L2_ETHERNET=y
CONFIG_NET_SHELL=y

CONFIG_NET_CONFIG_SETTINGS=y
#CONFIG_NET_CONFIG_MY_IPV6_ADDR="2001:db8::1"
#CONFIG_NET_CONFIG_PEER_IPV6_ADDR="2001:db8::2"
#CONFIG_NET_CONFIG_MY_IPV4_ADDR="192.0.2.1"
#CONFIG_NET_CONFIG_PEER_IPV4_ADDR="192.0.2.2"
CONFIG_NET_CONFIG_AUTO_INIT=y

CONFIG_NET_MGMT=y
CONFIG_NET_MGMT_EVENT=y
CONFIG_KERNEL_SHELL=y
CONFIG_SHELL_BACKEND_TELNET=y

CONFIG_LOG=y
CONFIG_SHELL_CMDS_RESIZE=n

CONFIG_BCB_SHELL=y
```

## src/main.c
```c
#include <zephyr.h>
#include <net/net_if.h>
#include <net/dhcpv4.h>

#define LOG_LEVEL LOG_LEVEL_DBG
#include <logging/log.h>
LOG_MODULE_REGISTER(main);

void main(void)
{	
    LOG_INF("Zperf Application");

    //struct net_if * iface = net_if_get_default();
    //net_dhcpv4_start(iface);
}
```

## src/breaker_shell.c
```c
/*
 * Copyright (c) 2015 Intel Corporation
 *
 * SPDX-License-Identifier: Apache-2.0
 */

#include <zephyr.h>
#include <sys/printk.h>
#include <shell/shell.h>
#include <shell/shell_uart.h>
#include <version.h>
#include <logging/log.h>
#include <stdlib.h>

#include <bcb.h>

LOG_MODULE_REGISTER(breaker_shell);

static void on_ocp(uint64_t duration)
{
    LOG_INF("[OCP] on->off duration: %"PRIu64"", duration);
}

static void on_ocpt(uint32_t reponse_time, int direction)
{
    LOG_INF("[OCPT] direction %c, response time: %"PRIu32" ns",
            (direction == BCB_OCP_TEST_TGR_DIR_P ? 'P' : 'N'),  
            BCB_ONOFF_TICKS_TO_NS(reponse_time));
}

static int cmd_off_params(const struct shell *shell, size_t argc, char **argv)
{
    ARG_UNUSED(argc);
    ARG_UNUSED(argv);

    bcb_off();

    return 0;
}

static int cmd_on_params(const struct shell *shell, size_t argc, char **argv)
{
    ARG_UNUSED(argc);
    ARG_UNUSED(argv);

    bcb_on();

    return 0;
}

static int cmd_ocp_trigger_params(const struct shell *shell, size_t argc, char **argv)
{
    ARG_UNUSED(argc);
    ARG_UNUSED(argv);

    int direction = BCB_OCP_TEST_TGR_DIR_P;
    if (argc > 1) {
        switch ((int)argv[1][0]) {
            case 'p':
            case 'P':
                direction = BCB_OCP_TEST_TGR_DIR_P;
                break;
            case 'n':
            case 'N':
                direction = BCB_OCP_TEST_TGR_DIR_N;
                break;
            default:
                direction = BCB_OCP_TEST_TGR_DIR_P;
        }
    } else {
        direction = BCB_OCP_TEST_TGR_DIR_P;
    }

    bcb_ocpt_trigger(direction, true);

    return 0;
}

static int cmd_version(const struct shell *shell, size_t argc, char **argv)
{
    ARG_UNUSED(argc);
    ARG_UNUSED(argv);

    shell_print(shell, "Zephyr version %s", KERNEL_VERSION_STRING);

    return 0;
}

SHELL_STATIC_SUBCMD_SET_CREATE(breaker_sub,
    SHELL_CMD(on, NULL, "Turn on.", cmd_on_params),
    SHELL_CMD(off, NULL, "Turn off.", cmd_off_params),
    SHELL_CMD(ocpt, NULL, "Trigger OCP.", cmd_ocp_trigger_params),
    SHELL_SUBCMD_SET_END /* Array terminated. */
);
SHELL_CMD_REGISTER(breaker, &breaker_sub, "Breaker commands", NULL);

SHELL_CMD_ARG_REGISTER(version, NULL, "Show kernel version", cmd_version, 1, 0);

void init_breaker_shell(void)
{
    bcb_set_ocp_callback(on_ocp);
    bcb_set_ocpt_callback(on_ocpt);
}
```

## src/breaker_shell.h
```c
#ifndef _BREAKER_SHELL_H_
#define _BREAKER_SHELL_H_

void init_breaker_shell(void);

#endif  // _BREAKER_SHELL_H_
```
