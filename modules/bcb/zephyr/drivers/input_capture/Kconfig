## modules/bcb/zephyr/drivers/input_capture/Kconfig
```kconfig
menuconfig INPUT_CAPTURE
	bool "Input Capture driver"

if INPUT_CAPTURE
rsource "Kconfig.mcux_ftm"
endif # INPUT_CAPTURE
```

## modules/bcb/zephyr/dts/bindings/blixt,breaker-gpio.yaml
```yaml
description: Digital inputs and output of the Blixt breaker

# Used to map nodes to bindings
compatible: "blixt,breaker-gpio"

properties:
    gpios:
      type: phandle-array
      required: true
    gpio-names:
      type: string-array
      required: true
    label:
      required: true
      type: string
```

## modules/bcb/zephyr/dts/bindings/blixt,pins.yaml
```yaml
description: Pin multiplexing configurations

# Used to map nodes to bindings
compatible: "blixt,pins"

properties:
    pinmuxs:
      type: phandle-array
      required: true
    pinmux-names:
      type: string-array
      required: true
    label:
      type: string
      required: true
```

## modules/bcb/zephyr/lib/Kconfig
```kconfig
menuconfig BCB_LIB
	bool "BCB Library"
	default n
	depends on BCB_EXTENSIONS

if BCB_LIB
	rsource "Kconfig.lib"
	rsource "Kconfig.init"
	rsource "Kconfig.config"
	rsource "Kconfig.tc_def"
	rsource "Kconfig.coap"
endif # BCB_LIB
```

## modules/bcb/zephyr/lib/Kconfig.config
```kconfig
menu "Persistent configurations"
	config BCB_LIB_PERSISTENT_CONFIG_OFFSET_IDENTITY
		int "Offset of the identity configurations"
		default 0

	config BCB_LIB_PERSISTENT_CONFIG_SIZE_IDENTITY
		int "Max size of the identity configurations"
		default 40

	config BCB_LIB_PERSISTENT_CONFIG_OFFSET_MSMNT
		int "Offset of the measurement configurations"
		default 40

	config BCB_LIB_PERSISTENT_CONFIG_SIZE_MSMNT
		int "Max size of the measurement configurations"
		default 160

	config BCB_LIB_PERSISTENT_CONFIG_OFFSET_BCB
		int "Offset of the breaker state configurations"
		default 200

	config BCB_LIB_PERSISTENT_CONFIG_SIZE_BCB
		int "Max size of the breaker state configurations"
		default 20

	config BCB_LIB_PERSISTENT_CONFIG_OFFSET_TC_DEF
		int "Offset of the default trip curve configurations"
		default 220
		depends on BCB_TRIP_CURVE_DEFAULT

	config BCB_LIB_PERSISTENT_CONFIG_SIZE_TC_DEF
		int "Max size of the default trip curve configurations"
		default 150

	config BCB_LIB_PERSISTENT_CONFIG_OFFSET_TC_DEF_MSM
		int "Offset of the main state machine configurations"
		default 370
		depends on BCB_TRIP_CURVE_DEFAULT

	config BCB_LIB_PERSISTENT_CONFIG_SIZE_TC_DEF_MSM
		int "Max size of the main state machine configurations"
		default 20
		depends on BCB_TRIP_CURVE_DEFAULT

	config BCB_LIB_PERSISTENT_CONFIG_OFFSET_TC_DEF_CSOM_MOD
		int "Offset of the modulation control state machine configurations"
		default 390
		depends on BCB_TRIP_CURVE_DEFAULT

	config BCB_LIB_PERSISTENT_CONFIG_SIZE_TC_DEF_CSOM_MOD
		int "Max size of the modulation control machine configurations"
		default 20
		depends on BCB_TRIP_CURVE_DEFAULT
endmenu
```

## modules/bcb/zephyr/lib/Kconfig.init
```kconfig
menu "Initialisation priorities"
	config BCB_LIB_SIM_INIT_PRIORITY
		int "SIM"
		default 50

	config BCB_LIB_TRIP_CURVE_DEFAULT_INIT_PRIORITY
		int "Default trip curve"
		default 51
		depends on BCB_TRIP_CURVE_DEFAULT

	config BCB_LIB_COAP_INIT_PRIORITY
		int "CoAP server"
		default 56
		depends on BCB_COAP

	config BCB_LIB_COAP_RESOURCE_INIT_PRIORITY
		int "CoAP resources"
		default 57
		depends on BCB_COAP
endmenu
```

## modules/bcb/zephyr/lib/Kconfig.lib
```kconfig
config BCB_SHELL
	bool "Shell"
	default n

config BCB_LIB_SW_MAX_TEMPERATURE
	int "OTP threshold (closed)"
	default 90

config BCB_LIB_SW_MAX_CLOSING_TEMPERATURE
	int "OTP threshold (before closed)"
	default 75

config BCB_LIB_SW_VITALS_CHECK_INTERVAL
	int "Vitals monitoring interval (ms)"
	default 100

menu "Timing"
	config BCB_LIB_ETIME_SECOND
		int "Number of ticks for one second of the elapsed time timer"
		default 30000000

	config BCB_LIB_IC_ONOFF_SECOND
		int "Number of ticks for one second of the on/off input capture timer"
		default 30000000
endmenu

menu "Measurements"
	config BCB_LIB_MSMNT_RMS_SAMPLES
		int "RMS samples (power of two)"
		default 7

	config BCB_LIB_MSMNT_RMS_INTERVAL
		int "RMS sampling interval (ms)"
		default 1
endmenu
```

## modules/bcb/zephyr/lib/Kconfig.tc_def
```kconfig
menuconfig BCB_TRIP_CURVE_DEFAULT
	bool "Default trip curve"
	default y

if BCB_TRIP_CURVE_DEFAULT
    config BCB_TRIP_CURVE_DEFAULT_SUPPLY_TIMER_TIMEOUT
        int "Time out for the supply detection timer in milliseconds"
        default 100

    config BCB_TRIP_CURVE_DEFAULT_SUPPLY_ZD_COUNT_MIN
        int "Minimum number of zero-cross detections for the supply detection step"
        default 8

    config BCB_TRIP_CURVE_DEFAULT_RECOVERY_TIMER_TIMEOUT
        int "Time out for the recovery timer in milliseconds"
        default 1

    config BCB_TRIP_CURVE_DEFAULT_MONITOR_INTERVAL
        int "Current monitoring interval for the default trip curve for DC in milliseconds"
        default 100

    config BCB_TRIP_CURVE_DEFAULT_MAX_POINTS
        int "Maximum number of configurable points for the default trip curve"
        default 16

endif # BCB_TRIP_CURVE_DEFAULT
```

## modules/bcb/zephyr/lib/bcb/Kconfig
```kconfig
config BCB_SHELL
	bool "Shell"
	default n

menuconfig BCB_COAP
	bool "CoAP"
	default n

if BCB_COAP
rsource "Kconfig.coap"
endif # BCB_COAP

config BCB_LIB_SW_MAX_CLOSING_TEMPERATURE
	int "Maximum temperature when the swtich can be closed"
	default 50

config BCB_LIB_SW_MAX_TEMPERATURE
	int "Maximum temperature that the swtich stays closed"
	default 90

config BCB_LIB_SW_VITALS_CHECK_INTERVAL
	int "Vitals monitoring interval in milliseconds"
	default 100

config BCB_TRIP_CURVE_DEFAULT
	bool "Default trip curve"
	default y

menu "Initialisation priorities"

config BCB_LIB_SIM_INIT_PRIORITY
	int "SIM initialisation priority"
	default 50

config BCB_LIB_TRIP_CURVE_DEFAULT_INIT_PRIORITY
	int "SIM initialisation priority"
	default 51
	depends on BCB_TRIP_CURVE_DEFAULT

config BCB_LIB_COAP_INIT_PRIORITY
	int "CoAP initialisation priority"
	default 56
	depends on BCB_COAP

config BCB_LIB_COAP_RESOURCE_INIT_PRIORITY
	int "CoAP resource initialisation priority"
	default 57
	depends on BCB_COAP

endmenu

menu "Timing"

config BCB_LIB_ETIME_SECOND
	int "Number of ticks for one second of the elapsed time timer"
	default 30000000

config BCB_LIB_IC_ONOFF_SECOND
	int "Number of ticks for one second of the on/off input capture timer"
	default 30000000

endmenu

menu "Measurements"

config BCB_LIB_MSMNT_RMS_SAMPLES
	int "Number of samples for RMS calculation as the power of two."
	default 7

config BCB_LIB_MSMNT_RMS_INTERVAL
	int "RMS sampling interval (ms)"
	default 1

endmenu

menu "Persistent configuration offsets/maximum sizes"

config BCB_LIB_PERSISTENT_CONFIG_OFFSET_IDENTITY
	int "Offset of the identity configurations"
	default 0

config BCB_LIB_PERSISTENT_CONFIG_SIZE_IDENTITY
	int "Max size of the identity configurations"
	default 40

config BCB_LIB_PERSISTENT_CONFIG_OFFSET_MSMNT
	int "Offset of the measurement configurations"
	default 40

config BCB_LIB_PERSISTENT_CONFIG_SIZE_MSMNT
	int "Max size of the measurement configurations"
	default 160

config BCB_LIB_PERSISTENT_CONFIG_OFFSET_BCB
	int "Offset of the breaker state configurations"
	default 200

config BCB_LIB_PERSISTENT_CONFIG_SIZE_BCB
	int "Max size of the breaker state configurations"
	default 20

config BCB_LIB_PERSISTENT_CONFIG_OFFSET_TRIP_CURVE_DEFAULT
	int "Offset of the default trip curve configurations"
	default 220
	depends on BCB_TRIP_CURVE_DEFAULT

config BCB_LIB_PERSISTENT_CONFIG_SIZE_TRIP_CURVE_DEFAULT
	int "Max size of the default trip curve configurations"
	default 20
	depends on BCB_TRIP_CURVE_DEFAULT

config BCB_LIB_PERSISTENT_CONFIG_OFFSET_COAP
	int "Offset of the CoAP configurations"
	default 240
	depends on BCB_COAP

config BCB_LIB_PERSISTENT_CONFIG_SIZE_COAP
	int "Max size of the CoAP configurations"
	default 20
	depends on BCB_COAP

endmenu
```

## modules/bcb/zephyr/lib/bcb/Kconfig.coap
```kconfig
config BCB_COAP_SERVER_PORT
	int "Server port"
	default 5683
	depends on BCB_COAP

config BCB_COAP_MAX_MSG_LEN
	int "Maximum message length"
	default 256
	depends on BCB_COAP

config BCB_COAP_MAX_PENDING
	int "Maximum number requests pending acknowledgments"
	default 2
	depends on BCB_COAP

config BCB_COAP_MAX_OBSERVERS
	int "Maximum number of observers"
	default 2
	depends on BCB_COAP

config BCB_COAP_MIN_OBSERVE_PERIOD
	int "Minimum observation period (ms)"
	default 100
	depends on BCB_COAP

config BCB_COAP_MAX_BUF_COUNT
	int "Maximum number of buffers"
	default 10
	depends on BCB_COAP

config BCB_COAP_MAX_USER_DATA_SIZE
	int "Maximum size of user data"
	default 24
	depends on BCB_COAP

config BCB_COAP_THREAD_STACK_SIZE
	int "Size of the thread stack"
	default 1024
	depends on BCB_COAP

config BCB_COAP_THREAD_PRIORITY
	int "Thread priority"
	default 1024
	depends on BCB_COAP
```

## modules/drivers/zephyr/Kconfig
```kconfig
config INPUT_CAPTURE_MCUX_FTM
    bool "Enable the input capture driver"
    default y
    depends on INPUT_CAPTURE

config COUNTER_CTD_MCUX_PIT
    bool "Enable MCUX PIT driver"
    default y
    depends on COUNTER_CTD


config COUNTER_MCUX_PIT
    bool "MCUX PIT driver"
    default y
    depends on COUNTER_CTD_MCUX_PIT

config ADC_MCUX_EDMA
    bool "DMA based ADC driver"
    default y
    depends on DMA_MCUX_EDMA && ADC_MCUX_ADC16

config ADC_MCUX_EDMA_CAL_R
    bool "Enable/disable repeated ADC calibration"
    default n
    depends on ADC_MCUX_EDMA

config ADC_MCUX_EDMA_CAL_R_SAMPLES
    int "Number of repeated ADC calibrations"
    default 40
    depends on ADC_MCUX_EDMA_CAL_R

config DMA_MCUX_EDMA
    bool "Enable EDMA"
    default y

config ADC_MCUX_ADC16
    bool "MCUX ADC16 driver"
    default y

config CMP_MCUX
    bool "Enable Comparator"
    default y

config SPI_MCUX_DSPI
    default y

config EEPROM_M95080
    bool "Enable EEPROM M95080"
    default y
    depends on SPI_MCUX_DSPI
```

## modules/extensions/zephyr/drivers/adc/Kconfig
```kconfig
menuconfig ADC
	bool "ADC driver"

if ADC
rsource "Kconfig.mcux_edma"
endif # ADC
```

## modules/extensions/zephyr/drivers/adc_trigger/Kconfig
```kconfig
menuconfig ADC_TRIGGER
	bool "ADC Trigger driver"

if ADC_TRIGGER
rsource "Kconfig.mcux_ftm"
rsource "Kconfig.mcux_lptmr"
endif # ADC_TRIGGER
```

## modules/extensions/zephyr/drivers/dma/Kconfig.mcux_edma
```kconfig
config DMA_MCUX_EDMA
	bool "MCUX EDMA driver"
	default y
	depends on HAS_MCUX_EDMA
```

## modules/extensions/zephyr/drivers/eeprom/Kconfig.m95080
```kconfig
config EEPROM_M95080
	bool "EEPROM M95080 driver"
	default y
	depends on SPI_MCUX_DSPI
```

## modules/extensions/zephyr/drivers/input_capture/Kconfig.mcux_ftm
```kconfig
config INPUT_CAPTURE_MCUX_FTM
	bool "MCUX FTM Input Capture driver"
	default y
	depends on HAS_MCUX_FTM
```

## modules/extensions/zephyr/dts/bindings/blixt,breaker-cmp.yaml
```yaml
description: Comparator channels of the Blixt Breaker

# Used to map nodes to bindings
compatible: "blixt,breaker-cmp"

include: base.yaml

properties:
    comparators:
      type: phandle-array
      required: true
    comparator-names:
      type: string-array
      required: true
    label:
      type: string
      required: true
```

## modules/extensions/zephyr/dts/bindings/nxp,kinetis-ftm-trigger.yaml
```yaml
# Copyright (c) 2017, NXP
# SPDX-License-Identifier: Apache-2.0

description: Kinetis FTM

compatible: "nxp,kinetis-ftm-trigger"

include: nxp,kinetis-ftm.yaml

properties:
  clock-source:
    type: int
    required: true
    description: Clock source of the FTM

  trigger-source:
    type: int
    required: true
    description: Channel of the trigger

  "#trigger-cells":
    type: int
    description: Number of items to expect in a trigger specifier

trigger-cells:
  - sim-config
```

## modules/extensions/zephyr/dts/bindings/nxp,kinetis-lptmr-trigger.yaml
```yaml
# Copyright (c) 2017, NXP
# SPDX-License-Identifier: Apache-2.0

description: Kinetis LPTMR Trigger

compatible: "nxp,kinetis-lptmr-trigger"

include: nxp,kinetis-lptmr.yaml

properties:
  clk-source:
    required: true
    enum:
      - 0
      - 1
      - 2
      - 3

  prescaler:
    type: int
    required: true
    enum:
      - 0
      - 1
      - 2
      - 3
      - 4
      - 5
      - 6
      - 7
      - 8
      - 9
      - 10
      - 11
      - 12
      - 13
      - 14
      - 15

  period:
    type: int
    required: true
    description: Clock period of the timer

  "#trigger-cells":
    type: int
    description: Number of items to expect in a trigger specifier

trigger-cells:
  - sim-config
```

## modules/extensions/zephyr/modules/Kconfig.mcux
```kconfig
if HAS_MCUX

config HAS_MCUX_EDMA
	bool
	help
	  Set if the EDMA module is present on the SoC.

config HAS_MCUX_PIT
	bool
	help
	  Set if the PIT module is present on the SoC.

config HAS_MCUX_LPTMR
	default y

endif # HAS_MCUX
```

## modules/extensions/zephyr/soc/Kconfig.soc
```kconfig
if SOC_MK64F12
config HAS_MCUX_EDMA
	default y

config HAS_MCUX_PIT
	default y
endif # SOC_MK64F12
```

## modules/lib/zephyr/Kconfig
```kconfig
config BCB_LIB_LEDS_INIT_PRIORITY
    int "BCB LEDs initialisation priority"
    default 50

config BCB_LIB_ETIME_INIT_PRIORITY
    int "BCB elapsed time timer initialisation priority"
    default 51

config BCB_LIB_MSMNT_INIT_PRIORITY
    int "BCB measurement initialisation priority"
    default 52

config BCB_LIB_CTRL_INIT_PRIORITY
    int "BCB control initialisation priority"
    default 53

config BCB_LIB_ZD_INIT_PRIORITY
    int "BCB zero detection initialisation priority"
    default 54

config BCB_LIB_SHELL_INIT_PRIORITY
    int "BCB shell initialisation priority"
    default 55

config BCB_LIB_ETIME_SECOND
    int "Number of ticks for one second of the elapsed time timer"
    default 30000000

config BCB_LIB_IC_ONOFF_SECOND
    int "Number of ticks for one second of the on/off input capture timer"
    default 30000000

config BCB_LIB_MSMNT_RMS_SAMPLES
    int "Number of samples used for RMS calculation as the power of two. Eg. if 5 used, 32 (2^5) samples"
    default 5

config BCB_SHELL
    bool "Enable BCB shell"
    default n
```
