## modules/zero/platform/Kconfig
```kconfig
config ZERO_MODULE
	bool "Module for Blixt Zero devices"
	default y

if ZERO_MODULE
rsource "drivers/Kconfig"
endif # ZERO_MODULE
```

## modules/zero/platform/boards/arm/zero/Kconfig.board
```kconfig
config BOARD_ZERO
	bool "Blixt Zero"
	depends on SOC_SERIES_KINETIS_K6X
	select SOC_PART_NUMBER_MK64FN1M0VLL12
```

## modules/zero/platform/boards/arm/zero/Kconfig.defconfig
```kconfig
if BOARD_ZERO

config BOARD
	default "zero"

config OSC_XTAL0_FREQ
	default 50000000

config MCG_PRDIV0
	default 0x13

config MCG_VDIV0
	default 0x18

config MCG_FCRDIV
	default 1

if NETWORKING

config NET_L2_ETHERNET
	default y

endif # NETWORKING

endif # BOARD_ZERO
```

## modules/zero/platform/boards/arm/zero/zero_defconfig
```kconfig
#### SOC
CONFIG_SOC_MK64F12=y
CONFIG_SOC_SERIES_KINETIS_K6X=y

#### System peripherals
CONFIG_ARM_MPU=y
CONFIG_HW_STACK_PROTECTION=y

#### Clock
CONFIG_SYS_CLOCK_HW_CYCLES_PER_SEC=120000000
CONFIG_OSC_EXTERNAL=y

CONFIG_CONSOLE=y
CONFIG_UART_CONSOLE=y

CONFIG_SERIAL=y
CONFIG_GPIO=y
CONFIG_PINCTRL=y

CONFIG_NEWLIB_LIBC=y
CONFIG_CMSIS_DSP=y
CONFIG_CMSIS_DSP_FASTMATH=y

CONFIG_BUILD_OUTPUT_HEX=y
```

## modules/zero/platform/drivers/Kconfig
```kconfig
menuconfig ADC_TRIGGER
	bool "ADC Trigger driver"
	default y

config ADC
	default y
	help
	  This is to override Zephyr's built-in configuration.

config DMA
	default y
	help
	  This is to override Zephyr's built-in configuration.

if ADC
rsource "adc/Kconfig"
endif # ADC

if ADC_TRIGGER
rsource "adc_trigger/Kconfig"
endif # ADC_TRIGGER

if DMA
rsource "dma/Kconfig"
endif # DMA

rsource "sici/Kconfig"
```

## modules/zero/platform/drivers/adc/Kconfig.mcux
```kconfig
config ADC_DMA_MCUX
	bool "MCUX ADC16 driver (DMA)"
	default y
	depends on DT_HAS_NXP_KINETIS_ADC16_EDMA_ENABLED
	help
	  Enable the MCUX ADC16 driver (DMA).

if ADC_DMA_MCUX

config ADC_MCUX_ADC16
	default y
	help
	  This is to override Zephyr's built-in configuration.

endif # ADC_DMA_MCUX
```

## modules/zero/platform/drivers/adc_trigger/Kconfig.mcux_ftm
```kconfig
config ADC_TRIGGER_MCUX_FTM
	bool "MCUX FTM ADC Trigger driver"
	default y
	depends on DT_HAS_NXP_KINETIS_ADC_TRIGGER_FTM_ENABLED
	help
	  Enable the MCUX ADC Trigger driver.

if ADC_TRIGGER_MCUX_FTM

config PWM_MCUX_FTM
	default y
	help
	  This is to override Zephyr's built-in configuration.

endif # ADC_TRIGGER_MCUX_FTM
```

## modules/zero/platform/drivers/adc_trigger/Kconfig.mcux_lptmr
```kconfig
config ADC_TRIGGER_MCUX_LPTMR
	bool "MCUX LPTMR ADC Trigger driver"
	default y
	depends on DT_HAS_NXP_KINETIS_ADC_TRIGGER_LPTMR_ENABLED
	help
	  Enable the MCUX LPTMR ADC Trigger driver.

if ADC_TRIGGER_MCUX_LPTMR

config COUNTER_MCUX_LPTMR
	default y
	help
	  This is to override Zephyr's built-in configuration.

endif # ADC_TRIGGER_MCUX_LPTMR
```

## modules/zero/platform/drivers/sici/Kconfig.sici
```kconfig
config SICI
	bool "Infineon SICI driver"
	default n
	depends on DT_HAS_INFINEON_SICI_ENABLED
	help
	  Enable Infineon SICI driver.

config SICI_INIT_PRIORITY
	int "SICI init priority"
	default KERNEL_INIT_PRIORITY_DEVICE
	help
	  SICI driver device initialization priority.
```

## modules/zero/platform/drivers/sici/Kconfig.tlx4971
```kconfig
config TLX4971
	bool "Infineon TLX4971 driver"
	default n
	depends on DT_HAS_INFINEON_TLX4971_ENABLED
	help
	  Enable Infineon TLX4971 driver.

if TLX4971

config TLX4971_SHELL
	bool "TLX4971 shell"
	default n
	depends on SHELL
	help
	  Enable the TLX4971 shell.

endif # TLX4971
```

## modules/zero/platform/dts/bindings/adc-trigger/nxp,kinetis-adc-trigger-ftm.yaml
```yaml
description: Kinetis FTM ADC Trigger

compatible: "nxp,kinetis-adc-trigger-ftm"

include: nxp,kinetis-ftm.yaml

properties:
  clock-source:
    type: int
    required: true
    enum:
      - 0
      - 1
      - 2
      - 3
    description: Clock source of the FTM

  clk-divider:
    type: int
    required: false
    enum:
      - 0
      - 1
      - 2
      - 3
      - 4
      - 5
      - 6
      - 7

  trigger-source:
    type: int
    required: true
    description: Channels to be used as the trigger source

  "#trigger-cells":
    type: int
    description: Number of items to expect in a trigger specifier

trigger-cells:
  - sim-config
```

## modules/zero/platform/dts/bindings/adc-trigger/nxp,kinetis-adc-trigger-lptmr.yaml
```yaml
description: Kinetis LPTMR ADC Trigger

compatible: "nxp,kinetis-adc-trigger-lptmr"

include: base.yaml

properties:
  reg:
    required: true

  interrupts:
    required: true

  clk-source:
    type: int
    required: true
    enum:
      - 0
      - 1
      - 2
      - 3
    description: Prescaler clock source (0 to 3)

  clk-divider:
    type: int
    required: false
    enum:
      - 0
      - 1
      - 2
      - 3
      - 4
      - 5
      - 6
      - 7
      - 8
      - 9
      - 10
      - 11
      - 12
      - 13
      - 14
      - 15
    description: Prescaler

  "#trigger-cells":
    type: int
    description: Number of items to expect in a trigger specifier

trigger-cells:
  - sim-config
```

## modules/zero/platform/dts/bindings/adc/nxp,kinetis-adc16-edma.yaml
```yaml
description: Kinetis ADC16 EDMA

compatible: "nxp,kinetis-adc16-edma"

include: ["adc-controller.yaml", "pinctrl-device.yaml"]

properties:
  reg:
    required: true

  interrupts:
    required: true

  triggers:
    required: true
    type: phandle-array
    description: The trigger used

  clk-source:
    type: int
    required: false
    description: ADC clock source

  clk-divider:
    type: int
    required: false
    enum:
      - 0
      - 1
      - 2
      - 3
    description: Clock divider

  long-sample:
    type: int
    required: false
    enum:
      - 0
      - 1
      - 2
      - 3
      - 4
    description: Long sample mode

  high-speed:
    type: boolean
    required: false
    description: If use high speed

  max-channels:
    required: true
    type: int
    description: Maximum number of ADC channels to be used by the driver

  "#io-channel-cells":
    type: int
    required: true

io-channel-cells:
  - main
  - alt
  - type
```

## modules/zero/platform/dts/bindings/breaker/blixt,breaker-aread.yaml
```yaml
description: ADC channels of the Blixt Breaker

compatible: "blixt,breaker-aread"

include: base.yaml

properties:
  io-channels:
    type: phandle-array
    required: true
  io-channel-names:
    type: string-array
    required: true
```

## modules/zero/platform/dts/bindings/sici/infineon,sici.yaml
```yaml
description: |
  Infineon Serial Inspection and Configuration Interface (SICI)

compatible: "infineon,sici"
bus: sici

include: [base.yaml, pinctrl-device.yaml]

properties:
  uart:
    required: true
    type: phandles
    description: The UART to be used.

  #  baud-enable:
  #    required: false
  #    type: int
  #    default: 9600
  #    description: The UART baudrate for enabling the interface.
  #
  #  byte-enable:
  #    required: false
  #    type: int
  #    default: 0xfe
  #    description: The UART byte to be transmitted for enabling the interface.

  baud-bit:
    required: false
    type: int
    default: 115200
    description: The UART baudrate for sending/receiving a bit.

  byte-sbit0:
    required: false
    type: int
    default: 0xfc
    description: The UART byte to be transmitted for sending bit-0.

  byte-sbit1:
    required: false
    type: int
    default: 0xc0
    description: The UART byte to be transmitted for sending bit-1.

  byte-rbit:
    required: false
    type: int
    default: 0xfe
    description: The UART byte to be transmitted for receiving a bit.

  pwr-en_gpios:
    required: true
    type: phandle-array
    description: The GPIO pin to control the power supply of the device.

  com-en-gpios:
    required: false
    type: phandle-array
    description: The GPIO pin to enable/disable the communication line to the device.

  com-gpios:
    required: false
    type: phandle-array
    description: The GPIO pin to pulldown to enter the communication mode of the device.
```

## modules/zero/platform/dts/bindings/sici/infineon,tli4971.yaml
```yaml
description: |
  Infineon TLx4971 family devices.

compatible: "infineon,tli4971"

include: [base.yaml, pinctrl-device.yaml]

properties:
  range:
    type: int
    required: false
    enum:
      - 0
      - 1
      - 2
      - 3
      - 4
      - 5
    description: The measurement range.

  op-mode:
    type: int
    required: false
    enum:
      - 0
      - 1
      - 2
      - 3
    description: The operating mode.

  ocd1-deglitch:
    type: int
    required: false
    enum:
      - 0
      - 1
      - 2
      - 3
      - 4
      - 5
      - 6
      - 7
    description: The deglitching time of the over-current channel 1.

  ocd2-deglitch:
    type: int
    required: false
    enum:
      - 0
      - 1
      - 2
      - 3
      - 4
      - 5
      - 6
      - 7
      - 8
      - 9
      - 10
      - 11
      - 12
      - 13
      - 14
      - 15
    description: The deglitching time of the over-current channel 2.

  ocd-comp-hyst:
    type: int
    required: false
    description: Over-current detection hysteresis setting.

  ocd1-thrsh:
    type: int
    required: false
    description: The threshold level of the over-current detection channel 1.

  ocd2-thrsh:
    type: int
    required: false
    description: The threshold level of the over-current detection channel 2.

  vref-ext:
    type: int
    required: false
    enum:
      - 0
      - 1
      - 2
      - 3
    description: External voltage reference settings.

  ocd1-enable:
    type: boolean
    default: true
    description: Enable over-current channel 1.

  ocd2-enable:
    type: boolean
    default: true
    description: Enable over-current channel 2.

  vref-gpios:
    required: false
    type: phandle-array
    description: The GPIO pin to enable/disable the external voltage reference.

  ocd1-gpios:
    required: false
    type: phandle-array
    description: The GPIO pin for over-current channel 1 interrupt.

  ocd2-gpios:
    required: false
    type: phandle-array
    description: The GPIO pin for over-current channel 2 interrupt.
```

## modules/zero/platform/dts/bindings/sici/infineon,tlx4971.yaml
```yaml
description: |
  Infineon TLx4971 family devices.

compatible: "infineon,tlx4971"
on-bus: sici

include: [base.yaml, pinctrl-device.yaml]

properties:
  range:
    type: int
    required: false
    enum:
      - 0
      - 1
      - 2
      - 3
      - 4
      - 5
    description: The measurement range setting.

  opmode:
    type: int
    required: false
    enum:
      - 0
      - 1
      - 2
      - 3
    description: The analogue output operating mode setting.

  ocd1-deglitch:
    type: int
    required: false
    enum:
      - 0
      - 1
      - 2
      - 3
      - 4
      - 5
      - 6
      - 7
    description: The deglitch time setting for OCD1.

  ocd2-deglitch:
    type: int
    required: false
    enum:
      - 0
      - 1
      - 2
      - 3
      - 4
      - 5
      - 6
      - 7
      - 8
      - 9
      - 10
      - 11
      - 12
      - 13
      - 14
      - 15
    description: The deglitch time setting for OCD2.

  ocd1-level:
    type: int
    required: false
    description: The threshold level for OCD1 in amperes.

  ocd2-level:
    type: int
    required: false
    description: The threshold level for OCD2 in amperes.

  ocd1-enable:
    type: boolean
    description: Enable OCD1.

  ocd2-enable:
    type: boolean
    description: Enable OCD2.

  prgm-gpios:
    required: false
    type: phandle-array
    description: The GPIO pin to apply programming voltage.

  error-gpios:
    required: false
    type: phandle-array
    description: The GPIO pin to indicate error status (e.g. combined output of OCD1 & OCD2 pins).
```

## west.yml
```yaml
manifest:
  defaults:
    remote: zephyrproject

  remotes:
    - name: zephyrproject
      url-base: https://github.com/zephyrproject-rtos
    - name: blixttech
      url-base: https://github.com/blixttech

  # Please add items below in alphabetic order
  # Only add a remote if different from the default
  projects:
    - name: cmsis
      revision: 542b2296e6d515b265e25c6b7208e8fea3014f90
      path: modules/hal/cmsis
    - name: mcuboot
      revision: e88113bbebe34ff2ccc6627ffae885cfeed6fdfd
      path: modules/bootloader/mcuboot
    - name: mcumgr
      remote: blixttech
      revision: 4ebb0b1a927bd9740b58610e2eec7f807fcf308a
      path: modules/lib/mcumgr
    - name: mbedtls
      path: modules/crypto/mbedtls
      revision: 4bf099f1254332d16dcd931ccea0a88d24a7d3c7
    - name: hal_nxp
      remote: blixttech
      revision: 274f6a6e68f81de8730253407448444caa4ef542
      path: modules/hal/nxp
    - name: tinycbor
      revision: 40daca97b478989884bffb5226e9ab73ca54b8c4
      path: modules/lib/tinycbor
    - name: zephyr
      revision: db56973d9864d6f75f9c421281727bde8d90501e
      remote: blixttech
      path: zephyr-os
      west-commands: scripts/west-commands.yml
    - name: zero-control-messages
      revision: 4e91084a74b4c5aae58f6c2591231508c9938243
      remote: blixttech
      path: modules/lib/zc-messages

  self:
    path: .
```
