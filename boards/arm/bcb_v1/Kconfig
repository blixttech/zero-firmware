## boards/arm/bcb_v1/Kconfig.board
```kconfig
# SPDX-License-Identifier: Apache-2.0

config BOARD_BCB_V1
	bool "Blixt Circuit Breaker (V1)"
	depends on SOC_SERIES_KINETIS_K6X
	select SOC_PART_NUMBER_MK64FN1M0VLL12
```

## boards/arm/bcb_v1/Kconfig.defconfig
```kconfig
if BOARD_BCB_V1

config BOARD
    default "bcb_v1"

if NETWORKING
config NET_L2_ETHERNET
    default y
config ETH_MCUX_0
    default y if NET_L2_ETHERNET
endif # NETWORKING

endif # BOARD_BCB_V1
```

## boards/arm/bcb_v1/bcb_v1_defconfig
```kconfig
#### SOC
CONFIG_SOC_MK64F12=y
CONFIG_SOC_SERIES_KINETIS_K6X=y

#### System peripherals
CONFIG_ARM_MPU=y

#### Clock
CONFIG_SYS_CLOCK_HW_CYCLES_PER_SEC=120000000
CONFIG_CORTEX_M_SYSTICK=y
CONFIG_OSC_EXTERNAL=y
# The reference clock output of the Ethernet PHY
CONFIG_OSC_XTAL0_FREQ=50000000
CONFIG_MCG_PRDIV0=0x13
CONFIG_MCG_VDIV0=0x18
CONFIG_MCG_FCRDIV=1

#### CMSIS
CONFIG_CMSIS_DSP=y
CONFIG_CMSIS_DSP_FASTMATH=y

#### Other peripherals
CONFIG_GPIO=y
CONFIG_PINMUX=y
CONFIG_SERIAL=y
CONFIG_SPI=y
CONFIG_ADC=y
CONFIG_DAC=y
CONFIG_PWM=y
CONFIG_DMA=y
CONFIG_COUNTER=y
CONFIG_EEPROM=y
CONFIG_INPUT_CAPTURE=y
CONFIG_ADC_TRIGGER=y

CONFIG_CONSOLE=y
CONFIG_UART_CONSOLE=y

# Peripheral drivers
CONFIG_PINMUX_MCUX_PORTA=y
CONFIG_PINMUX_MCUX_PORTB=y
CONFIG_PINMUX_MCUX_PORTC=y
CONFIG_PINMUX_MCUX_PORTD=y
CONFIG_PINMUX_MCUX_PORTE=y
CONFIG_DMA_MCUX_EDMA=y
CONFIG_COUNTER_MCUX_PIT=y
CONFIG_ADC_TRIGGER_MCUX_FTM=y
CONFIG_ADC_TRIGGER_MCUX_LPTMR=y
CONFIG_EEPROM_M95080=y

#### Libraries
CONFIG_NEWLIB_LIBC=y
CONFIG_BCB_LIB=y
CONFIG_BCB_DRIVERS=y
```

## dts/bindings/blixt,breaker-adc.yaml
```yaml
description: ADC channels of the Blixt Breaker

# Used to map nodes to bindings
compatible: "blixt,breaker-adc"

include: base.yaml

properties:
    io-channels:
      type: phandle-array
      required: true
    io-channel-names:
      type: string-array
      required: true
    label:
      type: string
      required: true
```

## dts/bindings/blixt,breaker-dac.yaml
```yaml
description: Digital to analog conversion output of the Blixt breaker

# Used to map nodes to bindings
compatible: "blixt,breaker-dac"

properties:
    io-channels:
      type: phandle-array
      required: false
      description: phandle array for DAC nodes
    io-channel-names:
      type: string-array
      required: false
      description: Name array for DAC nodes
    pwms:
      type: phandle-array
      required: false
    pwm-names:
      type: string-array
      required: false
    label:
      required: true
      type: string
```

## dts/bindings/blixt,breaker-gpio.yaml
```yaml
description: Digital inputs and output of the Blixt breaker

# Used to map nodes to bindings
compatible: "blixt,breaker-gpio"

properties:
    gpios:
      type: phandle-array
      required: true
      description: The associated IO pin
    label:
      required: true
      type: string
      description: Human readable string describing the device (used by Zephyr for API name)
```

## dts/bindings/blixt,breaker-input-timestamp.yaml
```yaml
description: Digital inputs time stamp of the Blixt Breaker

# Used to map nodes to bindings
compatible: "blixt,breaker-input-timestamp"

properties:
    input-captures:
      type: phandle-array
      required: true
    input-capture-names:
      type: string-array
      required: true
    label:
      required: true
      type: string
```

## dts/bindings/blixt,breaker-pins.yaml
```yaml
description: Digital inputs and output of the Blixt breaker

# Used to map nodes to bindings
compatible: "blixt,breaker-pins"

properties:
    pinmuxs:
      type: phandle-array
      required: true
    pinmux-names:
      type: string-array
      required: true
    label:
      type: string
      required: true
```

## dts/bindings/nxp,kinetis-adc16-edma.yaml
```yaml
# Copyright (c) 2017, NXP
# SPDX-License-Identifier: Apache-2.0

description: Kinetis ADC16

compatible: "nxp,kinetis-adc16-edma"

include: adc-controller.yaml

properties:
    reg:
      required: true

    interrupts:
      required: true

    triggers:
      required: true
      type: phandle-array
      description: The trigger used

    max-channels:
      required: true
      type: int
      description: Maximum number of ADC channels to be used by the driver

    dmas:
      required: true
      type: phandle-array
      description: DMA and MUX to be used

    dma-names:
      required: false
      type: string-array
      description: name of each DMA MUX selection

    sample-interval:
      required: true
      type: int
      description: Sample interval (us)

    "#io-channel-cells":
      const: 2

io-channel-cells:
    - input
    - muxsel
```

## dts/bindings/nxp,kinetis-cmp.yaml
```yaml
# Copyright (c) 2020, Blixt Tech
# SPDX-License-Identifier: Apache-2.0

description: Kinetis CMP

compatible: "nxp,kinetis-cmp"

include: base.yaml

properties:
    reg:
      required: true

    interrupts:
      required: true

    filter_count:
      type: int
      required: true

    filter_period:
      type: int
      required: true

    hysteresis:
      type: int
      required: true

    "#comparator-cells":
      type: int
      required: true
      const: 3
      description: Number of items to expect in a comparator specifier

comparator-cells:
  - inp
  - inn
  - edge
```

## dts/bindings/nxp,kinetis-ftm-input-capture.yaml
```yaml
# SPDX-License-Identifier: Apache-2.0

description: Kinetis FTM Input Capture

compatible: "nxp,kinetis-ftm-input-capture"

include: ["nxp,kinetis-ftm.yaml"]

properties:
  clock-source:
    type: int
    required: true
    description: Clock source of the FTM

  glitch-filter:
    type: int
    required: true
    description: Number of system clock cycles used for glitch filtering

  "#input-capture-cells":
    type: int
    required: true
    const: 2
    description: Number of items to expect in a input capture specifier

input-capture-cells:
  - channel
  - edge
```

## dts/bindings/nxp,kinetis-pit-ctd-counter.yaml
```yaml
# Copyright 2020 NXP
# SPDX-License-Identifier: Apache-2.0

description: NXP MCUX Periodic Interrupt Timer (PIT)

compatible: "nxp,kinetis-pit"

include: base.yaml

properties:
    reg:
      required: true

    interrupts:
      required: true
```

## dts/bindings/st,m95080.yaml
```yaml
description: ST M95080 family EEPROMs

compatible: "st,m95080"

include: [eeprom-spi-i2c.yaml, spi-device.yaml]
```

## manifest/west.yml
```yaml
manifest:
  defaults:
    remote: zephyrproject

  remotes:
    - name: zephyrproject
      url-base: https://github.com/zephyrproject-rtos
    - name: blixttech
      url-base: https://github.com/blixttech

  # Please add items below in alphabetic order
  # Only add a remote if different from the default
  projects:
    - name: cmsis
      revision: 74981bf893e8b10931464b9945e2143d99a3f0a3
      path: modules/hal/cmsis
    - name: hal_nxp
      revision: d957472002a3758154f402e982d95ce90cf58e12
      path: modules/hal/nxp
    - name: mbedtls
      revision: 6e166050075688fd3cf3d0cb3fc34a1c52df2496
      path: modules/crypto/mbedtls
    - name: mcuboot
      revision: 750678e33819b95756203e5db1ba827baee35708
      path: modules/bootloader/mcuboot
    - name: zcbor
      revision: 0.6.0
      path: modules/lib/zcbor
    - name: zephyr
      revision: zephyr-v3.3.0
      path: zephyr
      west-commands: scripts/west-commands.yml
      import: false
    - name: zero-control-messages
      remote: blixttech
      revision: 7e2fda793f12eeda6d792e5acae5aa05e6671589
      path: modules/zero/zc-messages

  self:
    path: manifest
```

## modules/bcb/zephyr/Kconfig
```kconfig
menuconfig BCB_EXTENSIONS
	bool "BCB extensions"
	default y
	depends on BOARD_BCB_V1

if BCB_EXTENSIONS
	rsource "modules/Kconfig"
	rsource "soc/Kconfig"
	rsource "drivers/Kconfig"
	rsource "lib/Kconfig"
endif # BCB_EXTENSIONS
```

## modules/bcb/zephyr/drivers/Kconfig
```kconfig
menuconfig BCB_DRIVERS
	bool "BCB Drivers"
	default n
	depends on BCB_EXTENSIONS

if BCB_DRIVERS

rsource "adc/Kconfig"
rsource "adc_trigger/Kconfig"
rsource "dma/Kconfig"
rsource "eeprom/Kconfig"
rsource "counter/Kconfig"
rsource "input_capture/Kconfig"

endif # BCB_DRIVERS
```

## modules/bcb/zephyr/drivers/adc/Kconfig.mcux_edma
```kconfig
config ADC_MCUX_EDMA
	bool "MCUX ADC-EDMA driver"
	default y
	depends on DMA_MCUX_EDMA

menu "ADC calibration"
	visible if ADC_MCUX_EDMA

config ADC_MCUX_EDMA_CAL_R
	bool "Repeated ADC calibration"
	default n

config ADC_MCUX_EDMA_CAL_R_SAMPLES
	int "Number of repeated ADC calibrations"
	default 40
	depends on ADC_MCUX_EDMA_CAL_R

endmenu
```

## modules/bcb/zephyr/drivers/adc_trigger/Kconfig
```kconfig
menuconfig ADC_TRIGGER
	bool "ADC Trigger driver"
	default n

if ADC_TRIGGER
rsource "Kconfig.mcux_ftm"
rsource "Kconfig.mcux_lptmr"
endif # ADC_TRIGGER
```

## modules/bcb/zephyr/drivers/adc_trigger/Kconfig.mcux_ftm
```kconfig
config ADC_TRIGGER_MCUX_FTM
	bool "MCUX FTM ADC Trigger driver"
	default n
	depends on HAS_MCUX_FTM
```

## modules/bcb/zephyr/drivers/adc_trigger/Kconfig.mcux_lptmr
```kconfig
config ADC_TRIGGER_MCUX_LPTMR
	bool "MCUX LPTMR ADC Trigger driver"
	default n
	depends on HAS_MCUX_LPTMR
	# HAL sources for LPTMR are enabled only if the following is set
	select COUNTER_MCUX_LPTMR
```

## modules/bcb/zephyr/drivers/counter/Kconfig
```kconfig
menuconfig COUNTER
	bool "Counter driver"

if COUNTER
rsource "Kconfig.mcux_pit"
endif
```

## modules/bcb/zephyr/drivers/counter/Kconfig.mcux_pit
```kconfig
config COUNTER_MCUX_PIT
	bool "MCUX PIT driver"
	default n
	depends on HAS_MCUX_PIT
```

## modules/bcb/zephyr/drivers/dma/Kconfig.mcux_edma
```kconfig
config DMA_MCUX_EDMA
	bool "MCUX EDMA driver"
	default n
	depends on HAS_MCUX_EDMA
```

## modules/bcb/zephyr/drivers/eeprom/Kconfig
```kconfig
menuconfig EEPROM
	bool "EEPROM driver"

if EEPROM
rsource "Kconfig.m95080"
endif # EEPROM
```
